

/* 包含头文件 -----------------------------------------------------------------*/
#include "QMC5883.h"


/* 私有函数 -------------------------------------------------------------------*/
/******************************************************************************
* @函数名称：void MPU6050_Init(void)
* @函数描述：MPU6050传感器初始化
* @输入参数：None
* @输出参数：None
*******************************************************************************/
u8 QMC5883_ReadReg(u8 Reg)
{
    u8 flag,Val;
	flag=I2C_read_onedata(QMC5883_ADDR,Reg,&Val);
	if(flag)
		return -1;
	return Val;
}
/******************************************************************************
* @函数名称：void MPU6050_Init(void)
* @函数描述：MPU6050传感器初始化
* @输入参数：None
* @输出参数：None
*******************************************************************************/
u8 QMC5883_WriteReg(u8 Val,u8 Reg)
{
	u8 flag;
	flag=I2C_write_onedata(QMC5883_ADDR,Reg,Val);
	return flag;
}
/******************************************************************************
* @函数名称：void MPU6050_Init(void)
* @函数描述：MPU6050传感器初始化
* @输入参数：None
* @输出参数：None
*******************************************************************************/
u8 QMC5883_ReadPage(u8 Reg,u8 *dat,uint n)
{
    u8 flag;
	flag=I2C_read_data(QMC5883_ADDR,Reg,dat,n);
	return flag;
}
/******************************************************************************
* @函数名称：void QMC5883_Init(void)
* @函数描述：程序入口
* @输入参数：None
* @输出参数：None
*******************************************************************************/
u8 QMC5883_InitConfig(void)
{
	u8 Temp;
	
	QMC5883_WriteReg(0x01, 0x0B);
	QMC5883_WriteReg(0x40, 0x20);
	QMC5883_WriteReg(0x01, 0x21);
	QMC5883_WriteReg(0x0D, 0x09);/****OSR=512,RNG=+/-2G,ODR=200Hz,MODE= continuous*******/
	delay_ms(2);///DELAY 2ms
	Temp = QMC5883_ReadReg(0x09);
	 if(Temp != 0x0D) return 1;	
    return 0;
}
/******************************************************************************
* @函数名称：void QMC5883_GetData(float *Magnet)
* @函数描述：获取地磁数据
* @输入参数：地磁buff
* @输出参数：None
*******************************************************************************/
u8 QMC5883_GetData(float *angle)
{
    u8 Buff[6],i;
    u8 Temp;
    int x,y,z;
    Temp = QMC5883_ReadReg(0x06);
    if (Temp&0x01 != 0x01)
    {
    	//LOG("output data not ready!")
    	return 1;
    }
    
    QMC5883_ReadPage(0x00,Buff,6);
	x = ((int)Buff[1] << 8) | Buff[0];
	y = ((int)Buff[3] << 8) | Buff[2];
	z = ((int)Buff[5] << 8) | Buff[4];

    *angle= atan2((double)y,(double)x) * (180 / 3.14159265);
	return 0;
}

/* 文件结束 --------------------------------------------------------------------*/
